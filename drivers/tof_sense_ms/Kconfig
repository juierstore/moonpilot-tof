## drivers/tof_sense_ms/Kconfig
```kconfig
menuconfig DRIVERS_DISTANCE_SENSOR_TOF_SENSE_MS
	bool "tof_sense_ms"
	default n
	---help---
		Enable support for the Nooploop TOFSense / TOFSense-F / TOFSense-S and
		TOFSense-M / TOFSense-MS laser range finders (NLink UART protocol).

		The driver streams frames from a serial port, validates the NLink
		checksum, reduces the 8x8 zone map of the M/MS series to a single
		distance and publishes it on the distance_sensor uORB topic.
```

## sim_test/Kconfig
```kconfig
menuconfig MODULES_TOF_GT_FRAMES
	bool "tof_gt_frames (SITL test helper)"
	default n
	---help---
		TEST ONLY helper: writes TOFSense-M NLink frames built from the SIH ground
		truth altitude into a file, for closed loop testing of the tof_sense_ms driver.
```

## src/drivers/distance_sensor/tof_sense_ms/Kconfig
```kconfig
menuconfig DRIVERS_DISTANCE_SENSOR_TOF_SENSE_MS
	bool "tof_sense_ms"
	default n
	---help---
		Enable support for the Nooploop TOFSense / TOFSense-F / TOFSense-S
		and TOFSense-M / TOFSense-MS laser range finders (NLink UART
		protocol).

		The driver streams frames from a standard PX4 serial port
		(selected with SENS_TOFMS_CFG in QGC), validates the NLink
		checksum, filters invalid zones, reduces the 8x8 / 4x4 zone map
		of the M/MS series to a single distance and publishes it on the
		distance_sensor uORB topic for EKF2.
```
